## conf/distro/ec.conf
```bitbake
require conf/distro/voltumna.conf

DISTRO_NAME = "EC"
SDK_VENDOR = "-ecsdk"
TARGET_VENDOR = "-ec"

OLDEST_KERNEL = "6.6"
LINUXLIBCVERSION = "6.6"
PREFERRED_VERSION_virtual/kernel ?= "6.6%"
PREFERRED_VERSION_linux-libc-headers ?= "6.6%"
PREFERRED_VERSION_linux-bb.org ?= "6.6%"
PREFERRED_VERSION_linux-xlnx ?= "6.6%"

PREFERRED_VERSION_nativesdk-libgfortran = "${GCCVERSION}"

PREFERRED_VERSION_tango-idl = "6.0%"
PREFERRED_VERSION_nativesdk-tango-idl = "6.0%"
PREFERRED_VERSION_cpptango = "10.3%"
PREFERRED_VERSION_nativesdk-cpptango = "10.3%"
PREFERRED_VERSION_nativesdk-pogo = "9.10%"

# Necessary to add lapack
FORTRAN:forcevariable = ",fortran"
RUNTIMETARGET:append:pn-gcc-runtime = " libquadmath"
HOSTTOOLS += "gfortran"
```

## conf/machine/mvme2500.conf
```bitbake
#@TYPE: Machine
#@NAME: MVME2500 machine
#@DESCRIPTION: Machine configuration for MVME2500 https://www.artesyn.com/computing/products/product/mvme2500-series-vme64-processor-board

require conf/machine/include/artesyn.inc
require conf/machine/include/powerpc/tune-ppce500v2.inc

SERIAL_CONSOLE = "9600 ttyS0"

KERNEL_IMAGETYPE = "zImage"
DEVICETREE = "mvme2500.dtb"
KERNEL_DEVICETREE = "fsl/${DEVICETREE}"

MACHINE_FEATURES = "pci serial ext2 usbhost"

IMAGE_BOOT_FILES ?= " \
	${DEVICETREE} \
	${KERNEL_IMAGETYPE} \
	"

PREFERRED_PROVIDER_virtual/bootloader ?= "u-boot-dummy"

IMAGE_FSTYPES = ""
WKS_FILE ?= "sdimage-bootpart.wks"

MACHINEOVERRIDES =. "vme:ppce500v2:e500v2:"
TUNE_FEATURES:tune-ppce500v2 += "spe"

# TODO Remove u-boot-mkimage
MACHINE_ESSENTIAL_EXTRA_RRECOMMENDS:append = " kernel-modules u-boot-mkimage"

PRIMARY_NETIF = "end0"
ROOT = ""

KERNEL_PROVIDER = "linux-artesyn-rt"
```

## conf/machine/mvme5100.conf
```bitbake
#@TYPE: Machine
#@NAME: MVME5100 machine
#@DESCRIPTION: Machine configuration for MVME5100

require conf/machine/include/artesyn.inc
require conf/machine/include/powerpc/tune-ppc7400.inc

SERIAL_CONSOLE = "9600 ttyS0"

KERNEL_IMAGETYPE = "dtbImage.mvme5100"

MACHINE_FEATURES = "pci serial"

IMAGE_FSTYPES = ""

ALLOW_EMPTY:${KERNEL_PACKAGE_NAME}-devicetree = "1"
PREFERRED_PROVIDER_virtual/bootloader ?= "nobootloader"

MACHINEOVERRIDES =. "vme:ppc7400:"

MACHINE_ESSENTIAL_EXTRA_RRECOMMENDS:append = " kernel-modules"

PRIMARY_NETIF = "enp0s14"
ROOT = ""

KERNEL_PROVIDER = "linux-artesyn-rt"
```

## conf/machine/mvme6100.conf
```bitbake
#@TYPE: Machine
#@NAME: MVME6100 machine
#@DESCRIPTION: Machine configuration for MVME6100

require conf/machine/include/artesyn.inc
require conf/machine/powerpc/tune-ppc7450.inc

SERIAL_CONSOLE = "9600 ttyS0"

KERNEL_IMAGETYPE = "dtbImage.mvme6100"

MACHINE_FEATURES = "pci serial"

IMAGE_FSTYPES ?= "tar"

ALLOW_EMPTY:${KERNEL_PACKAGE_NAME}-devicetree = "1"
PREFERRED_PROVIDER_virtual/bootloader ?= "nobootloader"

MACHINEOVERRIDES =. "vme:ppc7400:"

MACHINE_ESSENTIAL_EXTRA_RRECOMMENDS:append = " kernel-modules"

PRIMARY_NETIF = "eth0"
ROOT = ""

KERNEL_PROVIDER = "linux-artesyn-rt"
```

## conf/machine/mvme7100.conf
```bitbake
#@TYPE: Machine
#@NAME: MVME7100 machine
#@DESCRIPTION: Machine configuration for MVME7100 https://www.artesyn.com/computing/products/product/mvme7100-vme-sbc-with-freescale-mpc864xd-system-on-chip-processor

require conf/machine/include/artesyn.inc
require conf/machine/powerpc/tune-ppc7450.inc

SERIAL_CONSOLE = "9600 ttyS0"

KERNEL_IMAGETYPE = "dtbImage.mvme7100"

MACHINE_FEATURES = "pci serial ext2 usbhost"

IMAGE_FSTYPES = ""

ALLOW_EMPTY:${KERNEL_PACKAGE_NAME}-devicetree = "1"
PREFERRED_PROVIDER_virtual/bootloader ?= "nobootloader"

MACHINEOVERRIDES =. "vme:ppc7400:"

MACHINE_ESSENTIAL_EXTRA_RRECOMMENDS:append = " kernel-modules"

PRIMARY_NETIF = "eth0"
ROOT = ""

KERNEL_PROVIDER = "linux-artesyn-rt"
```
